## drivers/net/wireless/unisoc/Kconfig
```kconfig
config SPARD_WLAN_SUPPORT
	bool "Unisoc wireless Support"
	select AML_WIFI_DEVICE_UWE5621  if SPARD_WLAN_SUPPORT
	default n
	help
	  This is support for spreadtrum wireless chip.

if SPARD_WLAN_SUPPORT
source "drivers/net/wireless/unisoc/unisocwcn/Kconfig"
source "drivers/net/wireless/unisoc/unisocwifi/Kconfig"
source "drivers/net/wireless/unisoc/tty-sdio/Kconfig"
endif
```
